#include "cygnus.dtsi"

&kscan0 {
    diode-direction = "col2row";

    col-gpios
        = <&pro_micro 21 GPIO_ACTIVE_HIGH>  /* Col 0 */
        , <&pro_micro 20 GPIO_ACTIVE_HIGH>  /* Col 1 */
        , <&pro_micro 19 GPIO_ACTIVE_HIGH>  /* Col 2 */
        , <&pro_micro 18 GPIO_ACTIVE_HIGH>  /* Col 3 */
        , <&pro_micro 15 GPIO_ACTIVE_HIGH>  /* Col 4 */
        ;

    row-gpios
        = <&pro_micro 5 (GPIO_ACTIVE_HIGH | GPIO_PULL_DOWN)>  /* Row 0 */
        , <&pro_micro 6 (GPIO_ACTIVE_HIGH | GPIO_PULL_DOWN)>  /* Row 1 */
        , <&pro_micro 7 (GPIO_ACTIVE_HIGH | GPIO_PULL_DOWN)>  /* Row 2 */
        , <&pro_micro 8 (GPIO_ACTIVE_HIGH | GPIO_PULL_DOWN)>  /* Row 3 */
        ;
};
