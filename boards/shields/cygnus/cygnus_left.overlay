#include "cygnus.dtsi"

/* Left half, columns from outer pinky to inner: pins 20, 19, 18, 15, 14.
 * Thumb keys sit on columns 3 and 4 (pins 15 and 14). */
&kscan0 {
    col-gpios
        = <&pro_micro 20 GPIO_ACTIVE_HIGH>
        , <&pro_micro 19 GPIO_ACTIVE_HIGH>
        , <&pro_micro 18 GPIO_ACTIVE_HIGH>
        , <&pro_micro 15 GPIO_ACTIVE_HIGH>
        , <&pro_micro 14 GPIO_ACTIVE_HIGH>
        ;
};
