## boards/shields/cygnus/Kconfig.defconfig
```kconfig
if SHIELD_CYGNUS_LEFT || SHIELD_CYGNUS_RIGHT

config ZMK_KEYBOARD_NAME
    default "Cygnus"

config ZMK_SPLIT
    default y

endif
```

## boards/shields/ferris-sweep/Kconfig.defconfig
```kconfig
if SHIELD_FERRIS_SWEEP_LEFT || SHIELD_FERRIS_SWEEP_RIGHT

config ZMK_KEYBOARD_NAME
    default "Sweep"

config ZMK_SPLIT
    default y

endif
```

## boards/shields/ferris-sweep/Kconfig.shield
```kconfig
config SHIELD_FERRIS_SWEEP_LEFT
    def_bool $(shields_list_contains,sweep_left)

config SHIELD_FERRIS_SWEEP_RIGHT
    def_bool $(shields_list_contains,sweep_right)
```
