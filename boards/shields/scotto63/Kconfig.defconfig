## boards/shields/scotto63/Kconfig.defconfig
```kconfig
if SHIELD_SCOTTO63

# Name must be less than 16 characters long!
config ZMK_SCOTTO63
    default "scotto63"

endif
```

## config/west.yml
```yaml
manifest:
  defaults:
    revision: v0.3
  remotes:
    - name: zmkfirmware
      url-base: https://github.com/zmkfirmware
    - name: caksoylar
      url-base: https://github.com/caksoylar
    - name: carrefinho
      url-base: https://github.com/carrefinho
    - name: lhonda
      url-base: https://github.com/lhonda
  projects:
    - name: zmk
      remote: zmkfirmware
      revision: main
      import: app/west.yml
    - name: forager-zmk-module
      remote: carrefinho
      revision: main
    - name: zmk-rgbled-widget
      remote: caksoylar
      revision: main
    - name: unified-zmk-config-template
      remote: lhonda
      revision: main
  self:
    path: config   
```
