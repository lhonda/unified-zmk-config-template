dts
#include <dt-bindings/zmk/matrix_transform.h>

/ {
    chosen {
        zmk,kscan = &kscan0;
        zmk,matrix_transform = &default_transform;
    };

    kscan0: kscan {
        compatible = "zmk,kscan-gpio-matrix";
        // Define your row and column pins
        row-gpios = <&pro_micro 4 GPIO_ACTIVE_HIGH>,
                    <&pro_micro 5 GPIO_ACTIVE_HIGH>;
        col-gpios = <&pro_micro 6 (GPIO_ACTIVE_HIGH | GPIO_PULL_DOWN)>;
    };
};